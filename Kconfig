## Kconfig
```kconfig
# Copyright (c) 2021 Huawei Device Co., Ltd.
# Licensed under the Apache License, Version 2.0 (the "License");
# you may not use this file except in compliance with the License.
# You may obtain a copy of the License at
#
#     http://www.apache.org/licenses/LICENSE-2.0
#
# Unless required by applicable law or agreed to in writing, software
# distributed under the License is distributed on an "AS IS" BASIS,
# WITHOUT WARRANTIES OR CONDITIONS OF ANY KIND, either express or implied.
# See the License for the specific language governing permissions and
# limitations under the License.

mainmenu "Dsoftbus Configuration"

comment "Select discovery protocol"
config dsoftbus_feature_disc_coap
    bool "Enable discovery with coap"
    default y
    help
      Answer Y to enable discovery with coap

config dsoftbus_feature_disc_ble
    bool "Enable discovery with ble"
    default n
    help
      Answer Y to enable discovery with ble

comment "Select connection protocol"
config dsoftbus_feature_conn_tcp
    bool "Enable connection with tcp"
    default y
    help
      Answer Y to enable connection with tcp

config dsoftbus_feature_conn_br
    bool "Enable connection with br"
    default n
    help
      Answer Y to enable connection with br

config dsoftbus_feature_conn_ble
    bool "Enable connection with ble"
    default n
    help
      Answer Y to enable connection with ble

comment "Select transmission feature"
config dsoftbus_feature_trans_udp
    bool "Enable transmission with udp"
    default n
    help
      Answer Y to enable transmission with udp

config dsoftbus_feature_trans_udp_file
    bool "Enable file transmission"
    default n
    depends on enable_trans_udp
    help
      Answer Y to enable file transmission with udp

config dsoftbus_feature_trans_udp_stream
    bool "Enable stream transmission"
    default n
    depends on enable_trans_udp
    help
      Answer Y to enable stream transmission with udp

comment "Other configuration"
config dsoftbus_feature_auth_account
    bool "Enable auth account"
    default n
    help
      Answer Y to enable authenticate account

config enable_auto_networking
    bool "Enable automatic networking"
    default y
    help
      Answer Y to enable automatic networking
```
